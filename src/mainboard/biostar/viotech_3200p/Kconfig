## src/mainboard/biostar/viotech_3200p/Kconfig
```kconfig
##
## This file is part of the coreboot project.
##
## Copyright (C) 2018 Ludwig Jaffe <ludwig.jaffe@gmail.com>
##
## This program is free software: you can redistribute it and/or modify
## it under the terms of the GNU General Public License as published by
## the Free Software Foundation, either version 2 of the License, or
## (at your option) any later version.
##
## This program is distributed in the hope that it will be useful,
## but WITHOUT ANY WARRANTY; without even the implied warranty of
## MERCHANTABILITY or FITNESS FOR A PARTICULAR PURPOSE.  See the
## GNU General Public License for more details.
##

##
## Inspired from different via C7 boards
##



if BOARD_BIOSTAR_VIOTECH_3200P

config BOARD_SPECIFIC_OPTIONS # dummy
	def_bool y
	select CPU_VIA_NANO
	select NORTHBRIDGE_VIA_VX900
	select SUPERIO_ITE_IT8728F
	select HAVE_PIRQ_TABLE
	select PIRQ_ROUTE
	select HAVE_MP_TABLE
	#select HAVE_OPTION_TABLE
	#select HAVE_ACPI_TABLES
	#select HAVE_ACPI_RESUME
	#select BOARD_HAS_FADT
	select BOARD_ROMSIZE_KB_1024

config MAINBOARD_DIR
	string
	default biostar/viotech_3200p

config MAINBOARD_PART_NUMBER
	string
	default "VIOTECH-3200+"

config IRQ_SLOT_COUNT
	int
	default 13

endif # BOARD_BIOSTAR_VIOTECH_3200P
```
